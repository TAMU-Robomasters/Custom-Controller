#include <Arduino.h>
#include "driver/twai.h"

// CCadapter UART to CAN bridge
// this is only needed because dev board is hardware limited to 2 UART busses

// For esp32-s3 supermini + TJA1050 + 24v-5v step down converter

static const int CAN_TX_PIN = 4;
static const int CAN_RX_PIN = 5;

static const int VTM_UART_RX_PIN = 44;
static const int VTM_UART_TX_PIN = -1;   // TODO: implement sending data to VTM (for drawing dynamic data on the client)

// VTM baud is 115200, not 921600 like what the manual said
static const uint32_t VTM_BAUD = 115200;

static const uint32_t CAN_BITRATE = 1000000;

static const uint32_t CAN_ID_POLL_RTR = 0x350; 
static const uint32_t CAN_ID_RESP     = 0x351; 

// can reassembly format
static const int PAYLOAD_LEN = 30;
static const int NUM_SEGS = 5;
static const int BYTES_PER_SEG = 6;

// respond rate limit (prevents ice mode)
static const uint32_t MIN_REPLY_INTERVAL_MS = 10;

// CRC tables (verify data and prevent corruption)
// replaces manual bit shifting
static const uint8_t CRC8_INIT = 0xFF;
static const uint16_t CRC16_INIT = 0xFFFF;

static const uint8_t CRC8_TAB[256] = {
  0x00,0x5e,0xbc,0xe2,0x61,0x3f,0xdd,0x83,0xc2,0x9c,0x7e,0x20,0xa3,0xfd,0x1f,0x41,
  0x9d,0xc3,0x21,0x7f,0xfc,0xa2,0x40,0x1e,0x5f,0x01,0xe3,0xbd,0x3e,0x60,0x82,0xdc,
  0x23,0x7d,0x9f,0xc1,0x42,0x1c,0xfe,0xa0,0xe1,0xbf,0x5d,0x03,0x80,0xde,0x3c,0x62,
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  0x74,0x2a,0xc8,0x96,0x15,0x4b,0xa9,0xf7,0xb6,0xe8,0x0a,0x54,0xd7,0x89,0x6b,0x35
};

static const uint16_t CRC16_TAB[256] = {
  0x0000,0x1189,0x2312,0x329b,0x4624,0x57ad,0x6536,0x74bf,0x8c48,0x9dc1,0xaf5a,0xbed3,0xca6c,0xdbe5,0xe97e,0xf8f7,
  0x1081,0x0108,0x3393,0x221a,0x56a5,0x472c,0x75b7,0x643e,0x9cc9,0x8d40,0xbfdb,0xae52,0xdaed,0xcb64,0xf9ff,0xe876,
  0x2102,0x308b,0x0210,0x1399,0x6726,0x76af,0x4434,0x55bd,0xad4a,0xbcc3,0x8e58,0x9fd1,0xeb6e,0xfae7,0xc87c,0xd9f5,
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  0xf78f,0xe606,0xd49d,0xc514,0xb1ab,0xa022,0x92b9,0x8330,0x7bc7,0x6a4e,0x58d5,0x495c,0x3de3,0x2c6a,0x1ef1,0x0f78
};

static inline uint16_t crc16_update(uint16_t crc, uint8_t ch)
{
  return (uint16_t)((crc >> 8) ^ CRC16_TAB[(crc ^ ch) & 0xFF]);
}

static uint8_t crc8_calc(const uint8_t* msg, size_t len) {
  uint8_t crc = CRC8_INIT;
  while (len--) crc = CRC8_TAB[crc ^ *msg++];
  return crc;
}

static uint16_t crc16_calc(const uint8_t* msg, size_t len) {
  uint16_t crc = CRC16_INIT;
  while (len--) {
    uint8_t ch = *msg++;
    crc = (crc >> 8) ^ CRC16_TAB[(crc ^ ch) & 0xFF];
  }
  return crc;
}

static twai_timing_config_t timingFor(uint32_t bitrate) {
  switch (bitrate) {
    case 250000:  return TWAI_TIMING_CONFIG_250KBITS();
    case 500000:  return TWAI_TIMING_CONFIG_500KBITS();
    case 1000000: return TWAI_TIMING_CONFIG_1MBITS();
    default:      return TWAI_TIMING_CONFIG_1MBITS();
  }
}

static uint8_t latestPayload[PAYLOAD_LEN] = {0};
static volatile bool havePayload = false;
static uint8_t payloadSeq = 0;

// VTM UART frame parser
//  header: 0xA5, data_len(2), seq(1), crc8(1)
//  cmd_id(2) + payload[data_len] + crc16(2)

enum class RxState : uint8_t {
  WAIT_SOF,
  READ_HEADER_REST,   
  READ_BODY          
};

static RxState rxState = RxState::WAIT_SOF;
static uint8_t header[5] = {0};
static uint16_t dataLen = 0;
static uint8_t body[2 + 256 + 2]; // cmd(2) + payload(max 256) + crc16(2)
static uint16_t bodyNeed = 0;
static uint16_t bodyHave = 0;

static void resetParser() {
  rxState = RxState::WAIT_SOF;
  dataLen = 0;
  bodyNeed = 0;
  bodyHave = 0;
}

static void handleCompleteFrame(const uint8_t hdr[5], const uint8_t* b, uint16_t bLen) {
  // bLen = 2 + dataLen + 2
  if (bLen < 4) return;

  const uint16_t cmd = (uint16_t)b[0] | ((uint16_t)b[1] << 8);
  const uint8_t* payload = &b[2];
  const uint16_t payloadLen = (uint16_t)(bLen - 4);

  uint16_t calc = crc16_calc(hdr, 5);
  calc = crc16_calc(b, 2 + payloadLen);
}

static bool verifyCrc16_stream(const uint8_t hdr[5], const uint8_t* body, uint16_t bodyLen, uint16_t dataLen)
{
  if (bodyLen != (uint16_t)(2 + dataLen + 2)) return false;
  if (dataLen > 256) return false;

  const uint16_t got = (uint16_t)body[2 + dataLen] | ((uint16_t)body[2 + dataLen + 1] << 8);

  uint16_t crc = CRC16_INIT;

  // header
  for (int i = 0; i < 5; i++) crc = crc16_update(crc, hdr[i]);

  // cmd_id + payload
  const uint16_t n = (uint16_t)(2 + dataLen);
  for (uint16_t i = 0; i < n; i++) crc = crc16_update(crc, body[i]);

  return crc == got;
}

static void processUartByte(uint8_t ch) {
  switch (rxState) {
    case RxState::WAIT_SOF:
      if (ch == 0xA5) {
        header[0] = ch;
        rxState = RxState::READ_HEADER_REST;
        bodyHave = 0;
      }
      break;

    case RxState::READ_HEADER_REST:
      header[1 + bodyHave] = ch;
      bodyHave++;
      if (bodyHave == 4) {
        bodyHave = 0;
        dataLen = (uint16_t)header[1] | ((uint16_t)header[2] << 8);

        uint8_t crc8 = crc8_calc(header, 4);
        if (crc8 != header[4]) {
          resetParser();
          break;
        }

        if (dataLen > 256) { resetParser(); break; }
        bodyNeed = (uint16_t)(2 + dataLen + 2);
        rxState = RxState::READ_BODY;
      }
      break;

    case RxState::READ_BODY:
      if (bodyHave < sizeof(body)) body[bodyHave++] = ch;
      else { resetParser(); break; }

      if (bodyHave == bodyNeed) {
        if (verifyCrc16_stream(header, body, bodyNeed, dataLen)) {
          uint16_t cmd = (uint16_t)body[0] | ((uint16_t)body[1] << 8);
          if (cmd == 0x0302 && dataLen == 30) {
            memcpy(latestPayload, &body[2], 30);
            havePayload = true;
            payloadSeq++;
          }
        }
        resetParser();
      }
      break;
  }
}

// CAN message send ----------------------
static uint32_t lastReplyMs = 0;

static bool sendSegFrame(uint8_t seqVal, uint8_t seg, const uint8_t sixBytes[6]) {
  twai_message_t msg = {};
  msg.identifier = CAN_ID_RESP;
  msg.extd = 0;
  msg.rtr  = 0;
  msg.data_length_code = 8;
  msg.data[0] = seqVal;
  msg.data[1] = seg;
  memcpy(&msg.data[2], sixBytes, 6);
  return twai_transmit(&msg, pdMS_TO_TICKS(10)) == ESP_OK;
}

static void replyWithLatestPayload() {
  const uint32_t now = millis();
  if (now - lastReplyMs < MIN_REPLY_INTERVAL_MS) return;
  lastReplyMs = now;

  uint8_t local[PAYLOAD_LEN];
  if (havePayload) memcpy(local, latestPayload, PAYLOAD_LEN);
  else memset(local, 0, PAYLOAD_LEN);

  const uint8_t seqVal = payloadSeq;

  for (uint8_t seg = 0; seg < NUM_SEGS; seg++) {
    uint8_t chunk[6];
    memcpy(chunk, &local[seg * BYTES_PER_SEG], BYTES_PER_SEG);
    (void)sendSegFrame(seqVal, seg, chunk);
  }
}

void setup() {
  Serial.begin(115200);
  delay(200);

  // CAN init
  twai_general_config_t g_config =
      TWAI_GENERAL_CONFIG_DEFAULT((gpio_num_t)CAN_TX_PIN, (gpio_num_t)CAN_RX_PIN, TWAI_MODE_NORMAL);
  twai_timing_config_t t_config = timingFor(CAN_BITRATE);
  twai_filter_config_t f_config = TWAI_FILTER_CONFIG_ACCEPT_ALL();

  if (twai_driver_install(&g_config, &t_config, &f_config) != ESP_OK) {
    Serial.println("TWAI install failed");
    while (true) delay(1000);
  }
  if (twai_start() != ESP_OK) {
    Serial.println("TWAI start failed");
    while (true) delay(1000);
  }

  // UART init
  Serial1.begin(VTM_BAUD, SERIAL_8N1, VTM_UART_RX_PIN, VTM_UART_TX_PIN);

  Serial.printf("Bridge ready. VTM UART baud=%lu, CAN=%lu\n", (unsigned long)VTM_BAUD, (unsigned long)CAN_BITRATE);
  resetParser();
}

void loop() {
  while (Serial1.available()) {
    processUartByte((uint8_t)Serial1.read());
  }

  twai_message_t rx = {};
  esp_err_t err = twai_receive(&rx, pdMS_TO_TICKS(10));
  if (err == ESP_OK) {
    if (rx.identifier == CAN_ID_POLL_RTR && rx.rtr) {
      replyWithLatestPayload();
    }
  }

  // debug serial print
  static uint32_t lastPrint = 0;
  uint32_t now = millis();
  if (now - lastPrint > 1000) {
    lastPrint = now;
    Serial.printf("havePayload=%d payloadSeq=%u\n", havePayload ? 1 : 0, payloadSeq);
  }
}
